## PastData/ESP_IDF/ESP32_test_01/main/Kconfig.projbuild
```kconfig
# put here your custom config value
menu "Example Configuration"
config ESP_WIFI_SSID
    string "2KNG"
    default "myssid"
    help
	SSID (network name) for the example to connect to.

config ESP_WIFI_PASSWORD
    string "77120094"
    default "mypassword"
    help
	WiFi password (WPA or WPA2) for the example to use.
endmenu
```
